#define LOG_LEVEL 2
#include "ctarget.h"
#define NUMBER_OF_FEDERATES 1
#define TARGET_FILES_DIRECTORY "/Users/arthurdeng/Desktop/LFArduino/reactor-c/wheelchair/src-gen/lf_wheelchair"
#include "core/reactor.c"
#include "Arduino.h"
// Code generated by the Lingua Franca compiler from:
// file://Users/arthurdeng/Desktop/LFArduino/reactor-c/wheelchair/lf_wheelchair.lf
// Pins
int x = A4;
int y = A3;
int air_sensor = A0;
int joystick_sel_pin = 7;

// Mouse Movement Controls
const int sensitivity = 23; // larger sensitivity --> slower mouse
const unsigned long loop_period = 15; // larger loop_period --> more delay
int y_zero, x_zero;
boolean invert = true;

// Click Flags
int right_click_flag = 0;
int left_click_flag = 0;
int scroll_flag = 0;
int zoom_flag = 0;

// Debug Constants
boolean debug_cursor = false;
boolean debug_air_sensor = false;

// Multi Click Constants
int debounce_time = 20;   // Debounce timer in ms
int multi_click_time = 250;  // Time limit for multi clicks
int long_click_time = 250;  // time until "held-down clicks" register

// Air Sensor Constants
int rest = 361;
int max_sip = 13;
int max_puff = 648;

ClickButton key(joystick_sel_pin, LOW, CLICKBTN_PULLUP);
pinMode(x, INPUT);
pinMode(y, INPUT);
pinMode(air_sensor, INPUT);
pinMode(joystick_sel_pin, INPUT_PULLUP);
delay(1000);

Mouse.begin();
key.debounceTime = debounce_time;
key.multiclickTime = multi_click_time;
key.longClickTime = long_click_time;

y_zero = analogRead(y);
x_zero = analogRead(x);
rest = analogRead(air_sensor);
static unsigned long lastLoop;
// =============== START reactor class lf_wheelchair
typedef struct {
    trigger_t* trigger;
    bool is_present;
    bool has_value;
    lf_token_t* token;
} lf_wheelchair_loop_t;
typedef struct {
    lf_wheelchair_loop_t _lf_loop;
    reaction_t _lf__reaction_0;
    trigger_t _lf__startup;
    reaction_t* _lf__startup_reactions[1];
    trigger_t _lf__loop;
    reaction_t* _lf__loop_reactions[1];
} lf_wheelchair_self_t;
void lf_wheelchairreaction_function_0(void* instance_args) {
    #pragma GCC diagnostic push
    #pragma GCC diagnostic ignored "-Wunused-variable"
    lf_wheelchair_self_t* self = (lf_wheelchair_self_t*)instance_args;
    // Expose the action struct as a local variable whose name matches the action name.
    lf_wheelchair_loop_t* loop = &self->_lf_loop;
    // Set the fields of the action struct to match the current trigger.
    loop->is_present = (bool)self->_lf__loop.status;
    loop->has_value = ((self->_lf__loop.token) != NULL && (self->_lf__loop.token)->value != NULL);
    loop->token = (self->_lf__loop.token);
    #pragma GCC diagnostic pop
            
    int x_reading = analogRead(x);
    int y_reading = analogRead(y);
    int air_reading = analogRead(air_sensor);
    
    int y_val = (y_reading - y_zero) / sensitivity;
    int x_val = (x_reading - x_zero) / sensitivity;
    
    if (invert) {
        x_val *= -1;
        y_val *= -1;
    }
    
    if (debug_cursor) {
        Serial.print("y_zero :");
        Serial.println(y_zero);
        Serial.print("x_zero :");
        Serial.println(x_zero);
    
        Serial.print("y analog :");
        Serial.println(y_reading);
        Serial.print("x analog :");
        Serial.println(x_reading);
    
        Serial.print("sensitivity :");
        Serial.println(sensitivity);
    
        Serial.print("x value: ");
        Serial.println(x_val);
        Serial.print("y value: ");
        Serial.println(y_val);
    }
    
    if (debug_air_sensor) {
        Serial.println(air_reading);
    }
    
    // Move Mouse
    if (!scroll_flag && !zoom_flag) {
        if (y_val > 1 || y_val < -1) {
        Mouse.move(0, y_val, 0);  // move mouse on y axis
        }
        if (x_val > 1 || x_val < -1) {
        Mouse.move(x_val, 0, 0);  // move mouse on x axis
        }
        while (millis() - lastLoop < loop_period) {
        // delay
        }
        lastLoop = millis(); 
    }
    
    key.Update();
    Serial.println(rest - air_reading);
    
    
    // Detect Left and Right Clicks
    if (air_reading - rest < -100 && !left_click_flag) {
        left_click_flag = 1;
        Mouse.press(MOUSE_LEFT);
    } else if (air_reading - rest > -100 && air_reading - rest < 100 && left_click_flag) {
        left_click_flag = 0;
        Mouse.release(MOUSE_LEFT);
    }
    if (air_reading - rest > 100 && !right_click_flag) {
        right_click_flag = 1;
        Mouse.press(MOUSE_RIGHT);
    } else if (air_reading - rest > -100 && air_reading - rest < 100 && right_click_flag) {
        right_click_flag = 0;
        Mouse.release(MOUSE_RIGHT);
    }
    
    schedule(loop, 0);
        
}
lf_wheelchair_self_t* new_lf_wheelchair() {
    lf_wheelchair_self_t* self = (lf_wheelchair_self_t*)calloc(1, sizeof(lf_wheelchair_self_t));
    self->_lf_loop.trigger = &self->_lf__loop;
    self->_lf__reaction_0.number = 0;
    self->_lf__reaction_0.function = lf_wheelchairreaction_function_0;
    self->_lf__reaction_0.self = self;
    self->_lf__reaction_0.deadline_violation_handler = NULL;
    self->_lf__reaction_0.STP_handler = NULL;
    self->_lf__reaction_0.name = "?";
    self->_lf__startup_reactions[0] = &self->_lf__reaction_0;
    self->_lf__startup.last = NULL;
    self->_lf__startup.reactions = &self->_lf__startup_reactions[0];
    self->_lf__startup.number_of_reactions = 1;
    self->_lf__startup.is_timer = false;
    self->_lf__loop.last = NULL;
    self->_lf__loop_reactions[0] = &self->_lf__reaction_0;
    self->_lf__loop.reactions = &self->_lf__loop_reactions[0];
    self->_lf__loop.number_of_reactions = 1;
    self->_lf__loop.is_physical = false;
    self->_lf__loop.element_size = 0;
    return self;
}
void delete_lf_wheelchair(lf_wheelchair_self_t* self) {
    if (self->_lf__reaction_0.output_produced != NULL) {
        free(self->_lf__reaction_0.output_produced);
    }
    if (self->_lf__reaction_0.triggers != NULL) {
        free(self->_lf__reaction_0.triggers);
    }
    if (self->_lf__reaction_0.triggered_sizes != NULL) {
        free(self->_lf__reaction_0.triggered_sizes);
    }
    for(int i = 0; i < self->_lf__reaction_0.num_outputs; i++) {
        free(self->_lf__reaction_0.triggers[i]);
    }
    free(self);
}
// =============== END reactor class lf_wheelchair

void _lf_set_default_command_line_options() {
}
// Array of pointers to timer triggers to be scheduled in _lf_initialize_timers().
trigger_t** _lf_timer_triggers = NULL;
int _lf_timer_triggers_size = 0;
// Array of pointers to timer triggers to be scheduled in _lf_trigger_startup_reactions().
reaction_t* _lf_startup_reactions[1];
int _lf_startup_reactions_size = 1;
// Empty array of pointers to shutdown triggers.
reaction_t** _lf_shutdown_reactions = NULL;
int _lf_shutdown_reactions_size = 0;
trigger_t* _lf_action_for_port(int port_id) {
    return NULL;
}
void _lf_initialize_trigger_objects() {
    // Initialize the _lf_clock
    lf_initialize_clock();
    _lf_tokens_with_ref_count_size = 1;
    _lf_tokens_with_ref_count = (token_present_t*)malloc(1 * sizeof(token_present_t));
    // Create the array that will contain pointers to is_present fields to reset on each step.
    _lf_is_present_fields_size = 1;
    _lf_is_present_fields = (bool**)malloc(1 * sizeof(bool*));
    _lf_is_present_fields_abbreviated = (bool**)malloc(1 * sizeof(bool*));
    _lf_is_present_fields_abbreviated_size = 0;
    
    lf_wheelchair_self_t* lf_wheelchair_self = new_lf_wheelchair();
    _lf_startup_reactions[0] = &lf_wheelchair_self->_lf__reaction_0;
    lf_wheelchair_self->_lf__loop.offset = 0;
    lf_wheelchair_self->_lf__loop.period = -1;
    lf_wheelchair_self->_lf__loop.token = _lf_create_token(0);
    lf_wheelchair_self->_lf__loop.status = absent;
    _lf_tokens_with_ref_count[0].token
            = &lf_wheelchair_self->_lf__loop.token;
    _lf_tokens_with_ref_count[0].status
            = &lf_wheelchair_self->_lf__loop.status;
    _lf_tokens_with_ref_count[0].reset_is_present = true;
    //***** End initializing lf_wheelchair
    // Allocate memory.
    // Populate arrays of trigger pointers.
    // Total number of outputs (single ports and multiport channels) produced by the reaction.
    lf_wheelchair_self->_lf__reaction_0.num_outputs = 0;
    // Allocate arrays for triggering downstream reactions.
    if (lf_wheelchair_self->_lf__reaction_0.num_outputs > 0) {
        lf_wheelchair_self->_lf__reaction_0.output_produced 
                = (bool**)malloc(sizeof(bool*) * lf_wheelchair_self->_lf__reaction_0.num_outputs);
        lf_wheelchair_self->_lf__reaction_0.triggers 
                = (trigger_t***)malloc(sizeof(trigger_t**) * lf_wheelchair_self->_lf__reaction_0.num_outputs);
        lf_wheelchair_self->_lf__reaction_0.triggered_sizes 
                = (int*)calloc(lf_wheelchair_self->_lf__reaction_0.num_outputs, sizeof(int));
    }
    // Initialize the output_produced array.
    // Reaction 0 of lf_wheelchair does not depend on one maximal upstream reaction.
    lf_wheelchair_self->_lf__reaction_0.last_enabling_reaction = NULL;
    // doDeferredInitialize
    // Connect inputs and outputs for reactor lf_wheelchair.
    // END Connect inputs and outputs for reactor lf_wheelchair.
    // Add action lf_wheelchair.loop to array of is_present fields.
    _lf_is_present_fields[0] 
            = &lf_wheelchair_self->_lf_loop.is_present;
    lf_wheelchair_self->_lf__reaction_0.chain_id = 1;
    // index is the OR of level 0 and 
    // deadline 140737488355327 shifted left 16 bits.
    lf_wheelchair_self->_lf__reaction_0.index = 0x7fff0000LL;
}
void _lf_trigger_startup_reactions() {
    
    for (int i = 0; i < _lf_startup_reactions_size; i++) {
        if (_lf_startup_reactions[i] != NULL) {
            _lf_enqueue_reaction(_lf_startup_reactions[i]);
        }
    }
}
void _lf_initialize_timers() {
}
void logical_tag_complete(tag_t tag_to_send) {
}
bool _lf_trigger_shutdown_reactions() {                          
    for (int i = 0; i < _lf_shutdown_reactions_size; i++) {
        if (_lf_shutdown_reactions[i] != NULL) {
            _lf_enqueue_reaction(_lf_shutdown_reactions[i]);
        }
    }
    // Return true if there are shutdown reactions.
    return (_lf_shutdown_reactions_size > 0);
}
void terminate_execution() {}
