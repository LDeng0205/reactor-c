#define LOG_LEVEL 2
#include "ctarget.h"
#define NUMBER_OF_FEDERATES 1
#define TARGET_FILES_DIRECTORY "/Users/arthurdeng/Desktop/LFArduino/reactor-c/Tests/src-gen/ActionDelay"
#include "core/reactor.c"
// Code generated by the Lingua Franca compiler from:
// file://Users/arthurdeng/Desktop/LFArduino/reactor-c/Tests/ActionDelay.lf
#include <Arduino.h>;
// =============== START reactor class Source
typedef struct {
    int value;
    bool is_present;
    int num_destinations;
} source_out_t;
typedef struct {
    source_out_t _lf_out;
    int _lf_out_width;
    reaction_t _lf__reaction_0;
    trigger_t _lf__startup;
    reaction_t* _lf__startup_reactions[1];
} source_self_t;
void sourcereaction_function_0(void* instance_args) {
    #pragma GCC diagnostic push
    #pragma GCC diagnostic ignored "-Wunused-variable"
    source_self_t* self = (source_self_t*)instance_args;
    source_out_t* out = &self->_lf_out;
    #pragma GCC diagnostic pop
    SET(out, 1);
        
}
source_self_t* new_Source() {
    source_self_t* self = (source_self_t*)calloc(1, sizeof(source_self_t));
    self->_lf__reaction_0.number = 0;
    self->_lf__reaction_0.function = sourcereaction_function_0;
    self->_lf__reaction_0.self = self;
    self->_lf__reaction_0.deadline_violation_handler = NULL;
    self->_lf__reaction_0.STP_handler = NULL;
    self->_lf__reaction_0.name = "?";
    self->_lf__startup_reactions[0] = &self->_lf__reaction_0;
    self->_lf__startup.last = NULL;
    self->_lf__startup.reactions = &self->_lf__startup_reactions[0];
    self->_lf__startup.number_of_reactions = 1;
    self->_lf__startup.is_timer = false;
    return self;
}
void delete_Source(source_self_t* self) {
    if (self->_lf__reaction_0.output_produced != NULL) {
        free(self->_lf__reaction_0.output_produced);
    }
    if (self->_lf__reaction_0.triggers != NULL) {
        free(self->_lf__reaction_0.triggers);
    }
    if (self->_lf__reaction_0.triggered_sizes != NULL) {
        free(self->_lf__reaction_0.triggered_sizes);
    }
    for(int i = 0; i < self->_lf__reaction_0.num_outputs; i++) {
        free(self->_lf__reaction_0.triggers[i]);
    }
    free(self);
}
// =============== END reactor class Source

// =============== START reactor class Sink
typedef struct {
    int value;
    bool is_present;
    int num_destinations;
} sink_in_t;
typedef struct {
    sink_in_t* _lf_in;
    // width of -2 indicates that it is not a multiport.
    int _lf_in_width;
    // Default input (in case it does not get connected)
    sink_in_t _lf_default__in;
    reaction_t _lf__reaction_0;
    trigger_t _lf__in;
    reaction_t* _lf__in_reactions[1];
} sink_self_t;
void sinkreaction_function_0(void* instance_args) {
    #pragma GCC diagnostic push
    #pragma GCC diagnostic ignored "-Wunused-variable"
    sink_self_t* self = (sink_self_t*)instance_args;
    sink_in_t* in = self->_lf_in;
    int in_width = self->_lf_in_width;
    #pragma GCC diagnostic pop
    interval_t elapsed_logical = get_elapsed_logical_time();
    interval_t logical = get_logical_time();
    interval_t physical = get_physical_time();
    if (elapsed_logical != MSEC(100)) {
        Serial.println("FAILURE");
        exit(1);
    } else {
        Serial.println("SUCCESS. Elapsed logical time is 1000 msec.");
    }
        
}
sink_self_t* new_Sink() {
    sink_self_t* self = (sink_self_t*)calloc(1, sizeof(sink_self_t));
    // Set input by default to an always absent default input.
    self->_lf_in = &self->_lf_default__in;
    self->_lf__reaction_0.number = 0;
    self->_lf__reaction_0.function = sinkreaction_function_0;
    self->_lf__reaction_0.self = self;
    self->_lf__reaction_0.deadline_violation_handler = NULL;
    self->_lf__reaction_0.STP_handler = NULL;
    self->_lf__reaction_0.name = "?";
    self->_lf__in.last = NULL;
    self->_lf__in_reactions[0] = &self->_lf__reaction_0;
    self->_lf__in.reactions = &self->_lf__in_reactions[0];
    self->_lf__in.number_of_reactions = 1;
    self->_lf__in.element_size = sizeof(int);
    return self;
}
void delete_Sink(sink_self_t* self) {
    if (self->_lf__reaction_0.output_produced != NULL) {
        free(self->_lf__reaction_0.output_produced);
    }
    if (self->_lf__reaction_0.triggers != NULL) {
        free(self->_lf__reaction_0.triggers);
    }
    if (self->_lf__reaction_0.triggered_sizes != NULL) {
        free(self->_lf__reaction_0.triggered_sizes);
    }
    for(int i = 0; i < self->_lf__reaction_0.num_outputs; i++) {
        free(self->_lf__reaction_0.triggers[i]);
    }
    free(self);
}
// =============== END reactor class Sink

// =============== START reactor class GeneratedDelay
typedef struct {
    int value;
    bool is_present;
    int num_destinations;
} generateddelay_y_in_t;
typedef struct {
    int value;
    bool is_present;
    int num_destinations;
} generateddelay_y_out_t;
typedef struct {
    trigger_t* trigger;
    bool is_present;
    bool has_value;
    lf_token_t* token;
} generateddelay_act_t;
typedef struct {
    int y_state;
    generateddelay_act_t _lf_act;
    generateddelay_y_in_t* _lf_y_in;
    // width of -2 indicates that it is not a multiport.
    int _lf_y_in_width;
    // Default input (in case it does not get connected)
    generateddelay_y_in_t _lf_default__y_in;
    generateddelay_y_out_t _lf_y_out;
    int _lf_y_out_width;
    reaction_t _lf__reaction_0;
    reaction_t _lf__reaction_1;
    trigger_t _lf__act;
    reaction_t* _lf__act_reactions[1];
    trigger_t _lf__y_in;
    reaction_t* _lf__y_in_reactions[1];
} generateddelay_self_t;
void generateddelayreaction_function_0(void* instance_args) {
    #pragma GCC diagnostic push
    #pragma GCC diagnostic ignored "-Wunused-variable"
    generateddelay_self_t* self = (generateddelay_self_t*)instance_args;
    generateddelay_y_in_t* y_in = self->_lf_y_in;
    int y_in_width = self->_lf_y_in_width;
    generateddelay_act_t* act = &self->_lf_act;
    #pragma GCC diagnostic pop
    self->y_state = y_in->value;
    schedule(act, MSEC(0));
    digitalWrite(LED_BUILTIN, HIGH); 
        
}
void generateddelayreaction_function_1(void* instance_args) {
    #pragma GCC diagnostic push
    #pragma GCC diagnostic ignored "-Wunused-variable"
    generateddelay_self_t* self = (generateddelay_self_t*)instance_args;
    // Expose the action struct as a local variable whose name matches the action name.
    generateddelay_act_t* act = &self->_lf_act;
    // Set the fields of the action struct to match the current trigger.
    act->is_present = (bool)self->_lf__act.status;
    act->has_value = ((self->_lf__act.token) != NULL && (self->_lf__act.token)->value != NULL);
    act->token = (self->_lf__act.token);
    generateddelay_y_out_t* y_out = &self->_lf_y_out;
    #pragma GCC diagnostic pop
    SET(y_out, self->y_state);
    digitalWrite(LED_BUILTIN, LOW); 
        
}
generateddelay_self_t* new_GeneratedDelay() {
    generateddelay_self_t* self = (generateddelay_self_t*)calloc(1, sizeof(generateddelay_self_t));
    self->_lf_act.trigger = &self->_lf__act;
    // Set input by default to an always absent default input.
    self->_lf_y_in = &self->_lf_default__y_in;
    self->_lf__reaction_0.number = 0;
    self->_lf__reaction_0.function = generateddelayreaction_function_0;
    self->_lf__reaction_0.self = self;
    self->_lf__reaction_0.deadline_violation_handler = NULL;
    self->_lf__reaction_0.STP_handler = NULL;
    self->_lf__reaction_0.name = "?";
    self->_lf__reaction_1.number = 1;
    self->_lf__reaction_1.function = generateddelayreaction_function_1;
    self->_lf__reaction_1.self = self;
    self->_lf__reaction_1.deadline_violation_handler = NULL;
    self->_lf__reaction_1.STP_handler = NULL;
    self->_lf__reaction_1.name = "?";
    self->_lf__act.last = NULL;
    self->_lf__act_reactions[0] = &self->_lf__reaction_1;
    self->_lf__act.reactions = &self->_lf__act_reactions[0];
    self->_lf__act.number_of_reactions = 1;
    self->_lf__act.is_physical = false;
    self->_lf__act.element_size = 0;
    self->_lf__y_in.last = NULL;
    self->_lf__y_in_reactions[0] = &self->_lf__reaction_0;
    self->_lf__y_in.reactions = &self->_lf__y_in_reactions[0];
    self->_lf__y_in.number_of_reactions = 1;
    self->_lf__y_in.element_size = sizeof(int);
    return self;
}
void delete_GeneratedDelay(generateddelay_self_t* self) {
    if (self->_lf__reaction_0.output_produced != NULL) {
        free(self->_lf__reaction_0.output_produced);
    }
    if (self->_lf__reaction_0.triggers != NULL) {
        free(self->_lf__reaction_0.triggers);
    }
    if (self->_lf__reaction_0.triggered_sizes != NULL) {
        free(self->_lf__reaction_0.triggered_sizes);
    }
    if (self->_lf__reaction_1.output_produced != NULL) {
        free(self->_lf__reaction_1.output_produced);
    }
    if (self->_lf__reaction_1.triggers != NULL) {
        free(self->_lf__reaction_1.triggers);
    }
    if (self->_lf__reaction_1.triggered_sizes != NULL) {
        free(self->_lf__reaction_1.triggered_sizes);
    }
    for(int i = 0; i < self->_lf__reaction_0.num_outputs; i++) {
        free(self->_lf__reaction_0.triggers[i]);
    }
    for(int i = 0; i < self->_lf__reaction_1.num_outputs; i++) {
        free(self->_lf__reaction_1.triggers[i]);
    }
    free(self);
}
// =============== END reactor class GeneratedDelay

// =============== START reactor class ActionDelay
typedef struct {
    reaction_t _lf__reaction_0;
    trigger_t _lf__startup;
    reaction_t* _lf__startup_reactions[1];
} actiondelay_self_t;
void actiondelayreaction_function_0(void* instance_args) {
    #pragma GCC diagnostic push
    #pragma GCC diagnostic ignored "-Wunused-variable"
    actiondelay_self_t* self = (actiondelay_self_t*)instance_args;
    
    #pragma GCC diagnostic pop
    pinMode(LED_BUILTIN, OUTPUT);
    Serial.begin(115200);
        
}
actiondelay_self_t* new_ActionDelay() {
    actiondelay_self_t* self = (actiondelay_self_t*)calloc(1, sizeof(actiondelay_self_t));
    self->_lf__reaction_0.number = 0;
    self->_lf__reaction_0.function = actiondelayreaction_function_0;
    self->_lf__reaction_0.self = self;
    self->_lf__reaction_0.deadline_violation_handler = NULL;
    self->_lf__reaction_0.STP_handler = NULL;
    self->_lf__reaction_0.name = "?";
    self->_lf__startup_reactions[0] = &self->_lf__reaction_0;
    self->_lf__startup.last = NULL;
    self->_lf__startup.reactions = &self->_lf__startup_reactions[0];
    self->_lf__startup.number_of_reactions = 1;
    self->_lf__startup.is_timer = false;
    return self;
}
void delete_ActionDelay(actiondelay_self_t* self) {
    if (self->_lf__reaction_0.output_produced != NULL) {
        free(self->_lf__reaction_0.output_produced);
    }
    if (self->_lf__reaction_0.triggers != NULL) {
        free(self->_lf__reaction_0.triggers);
    }
    if (self->_lf__reaction_0.triggered_sizes != NULL) {
        free(self->_lf__reaction_0.triggered_sizes);
    }
    for(int i = 0; i < self->_lf__reaction_0.num_outputs; i++) {
        free(self->_lf__reaction_0.triggers[i]);
    }
    free(self);
}
// =============== END reactor class ActionDelay

void _lf_set_default_command_line_options() {
}
// Array of pointers to timer triggers to be scheduled in _lf_initialize_timers().
trigger_t** _lf_timer_triggers = NULL;
int _lf_timer_triggers_size = 0;
// Array of pointers to timer triggers to be scheduled in _lf_trigger_startup_reactions().
reaction_t* _lf_startup_reactions[2];
int _lf_startup_reactions_size = 2;
// Empty array of pointers to shutdown triggers.
reaction_t** _lf_shutdown_reactions = NULL;
int _lf_shutdown_reactions_size = 0;
trigger_t* _lf_action_for_port(int port_id) {
    return NULL;
}
void _lf_initialize_trigger_objects() {
    // Initialize the _lf_clock
    lf_initialize_clock();
    _lf_tokens_with_ref_count_size = 1;
    _lf_tokens_with_ref_count = (token_present_t*)malloc(1 * sizeof(token_present_t));
    // Create the array that will contain pointers to is_present fields to reset on each step.
    _lf_is_present_fields_size = 3;
    _lf_is_present_fields = (bool**)malloc(3 * sizeof(bool*));
    
    // ************* Instance ActionDelay of class ActionDelay
    actiondelay_self_t* actiondelay_self = new_ActionDelay();
    //***** Start initializing ActionDelay
    _lf_startup_reactions[0] = &actiondelay_self->_lf__reaction_0;
    // ************* Instance ActionDelay.source of class Source
    source_self_t* actiondelay_source_self = new_Source();
    //***** Start initializing ActionDelay.source
    // width of -2 indicates that it is not a multiport.
    actiondelay_source_self->_lf_out_width = -2;
    _lf_startup_reactions[1] = &actiondelay_source_self->_lf__reaction_0;
    //***** End initializing ActionDelay.source
    // ************* Instance ActionDelay.sink of class Sink
    sink_self_t* actiondelay_sink_self = new_Sink();
    //***** Start initializing ActionDelay.sink
    // width of -2 indicates that it is not a multiport.
    actiondelay_sink_self->_lf_in_width = -2;
    //***** End initializing ActionDelay.sink
    // ************* Instance ActionDelay.g of class GeneratedDelay
    generateddelay_self_t* actiondelay_g_self = new_GeneratedDelay();
    //***** Start initializing ActionDelay.g
    // width of -2 indicates that it is not a multiport.
    actiondelay_g_self->_lf_y_out_width = -2;
    // width of -2 indicates that it is not a multiport.
    actiondelay_g_self->_lf_y_in_width = -2;
    static int actiondelay_g_initial_y_state = 0;
    actiondelay_g_self->y_state = actiondelay_g_initial_y_state;
    actiondelay_g_self->_lf__act.offset = MSEC(1000);
    actiondelay_g_self->_lf__act.period = -1;
    actiondelay_g_self->_lf__act.token = _lf_create_token(0);
    actiondelay_g_self->_lf__act.status = absent;
    _lf_tokens_with_ref_count[0].token
            = &actiondelay_g_self->_lf__act.token;
    _lf_tokens_with_ref_count[0].status
            = &actiondelay_g_self->_lf__act.status;
    _lf_tokens_with_ref_count[0].reset_is_present = true;
    //***** End initializing ActionDelay.g
    //***** End initializing ActionDelay
    // Populate arrays of trigger pointers.
    // Total number of outputs produced by the reaction.
    actiondelay_self->_lf__reaction_0.num_outputs = 0;
    // Allocate arrays for triggering downstream reactions.
    if (actiondelay_self->_lf__reaction_0.num_outputs > 0) {
        actiondelay_self->_lf__reaction_0.output_produced 
                = (bool**)malloc(sizeof(bool*) * actiondelay_self->_lf__reaction_0.num_outputs);
        actiondelay_self->_lf__reaction_0.triggers 
                = (trigger_t***)malloc(sizeof(trigger_t**) * actiondelay_self->_lf__reaction_0.num_outputs);
        actiondelay_self->_lf__reaction_0.triggered_sizes 
                = (int*)calloc(actiondelay_self->_lf__reaction_0.num_outputs, sizeof(int));
    }
    // Initialize the output_produced array.
    // Reaction 0 of ActionDelay does not depend on one maximal upstream reaction.
    actiondelay_self->_lf__reaction_0.last_enabling_reaction = NULL;
    // Total number of outputs produced by the reaction.
    actiondelay_source_self->_lf__reaction_0.num_outputs = 1;
    // Allocate arrays for triggering downstream reactions.
    if (actiondelay_source_self->_lf__reaction_0.num_outputs > 0) {
        actiondelay_source_self->_lf__reaction_0.output_produced 
                = (bool**)malloc(sizeof(bool*) * actiondelay_source_self->_lf__reaction_0.num_outputs);
        actiondelay_source_self->_lf__reaction_0.triggers 
                = (trigger_t***)malloc(sizeof(trigger_t**) * actiondelay_source_self->_lf__reaction_0.num_outputs);
        actiondelay_source_self->_lf__reaction_0.triggered_sizes 
                = (int*)calloc(actiondelay_source_self->_lf__reaction_0.num_outputs, sizeof(int));
    }
    // Initialize the output_produced array.
    actiondelay_source_self->_lf__reaction_0.output_produced[0]
    = &actiondelay_source_self->_lf_out.is_present;
    // Reaction 0 of ActionDelay.source does not depend on one maximal upstream reaction.
    actiondelay_source_self->_lf__reaction_0.last_enabling_reaction = NULL;
    // Reaction 0 of ActionDelay.source triggers 1
    // downstream reactions through port ActionDelay.source.out.
    actiondelay_source_self->_lf__reaction_0.triggered_sizes[0] = 1;
    // For reaction 0 of ActionDelay.source, allocate an
    // array of trigger pointers for downstream reactions through port ActionDelay.source.out
    trigger_t** actiondelay_source_0_0 = (trigger_t**)malloc(1 * sizeof(trigger_t*));
    actiondelay_source_self->_lf__reaction_0.triggers[0] = actiondelay_source_0_0;
    // Point to destination port ActionDelay.g.y_in's trigger struct.
    actiondelay_source_0_0[0] = &actiondelay_g_self->_lf__y_in;
    actiondelay_source_self->_lf_out.num_destinations = 1;
    // Total number of outputs produced by the reaction.
    actiondelay_sink_self->_lf__reaction_0.num_outputs = 0;
    // Allocate arrays for triggering downstream reactions.
    if (actiondelay_sink_self->_lf__reaction_0.num_outputs > 0) {
        actiondelay_sink_self->_lf__reaction_0.output_produced 
                = (bool**)malloc(sizeof(bool*) * actiondelay_sink_self->_lf__reaction_0.num_outputs);
        actiondelay_sink_self->_lf__reaction_0.triggers 
                = (trigger_t***)malloc(sizeof(trigger_t**) * actiondelay_sink_self->_lf__reaction_0.num_outputs);
        actiondelay_sink_self->_lf__reaction_0.triggered_sizes 
                = (int*)calloc(actiondelay_sink_self->_lf__reaction_0.num_outputs, sizeof(int));
    }
    // Initialize the output_produced array.
    // Reaction 0 of ActionDelay.sink depends on one maximal upstream reaction.
    actiondelay_sink_self->_lf__reaction_0.last_enabling_reaction = &(actiondelay_g_self->_lf__reaction_1);
    // Total number of outputs produced by the reaction.
    actiondelay_g_self->_lf__reaction_0.num_outputs = 0;
    // Allocate arrays for triggering downstream reactions.
    if (actiondelay_g_self->_lf__reaction_0.num_outputs > 0) {
        actiondelay_g_self->_lf__reaction_0.output_produced 
                = (bool**)malloc(sizeof(bool*) * actiondelay_g_self->_lf__reaction_0.num_outputs);
        actiondelay_g_self->_lf__reaction_0.triggers 
                = (trigger_t***)malloc(sizeof(trigger_t**) * actiondelay_g_self->_lf__reaction_0.num_outputs);
        actiondelay_g_self->_lf__reaction_0.triggered_sizes 
                = (int*)calloc(actiondelay_g_self->_lf__reaction_0.num_outputs, sizeof(int));
    }
    // Initialize the output_produced array.
    // Total number of outputs produced by the reaction.
    actiondelay_g_self->_lf__reaction_1.num_outputs = 1;
    // Allocate arrays for triggering downstream reactions.
    if (actiondelay_g_self->_lf__reaction_1.num_outputs > 0) {
        actiondelay_g_self->_lf__reaction_1.output_produced 
                = (bool**)malloc(sizeof(bool*) * actiondelay_g_self->_lf__reaction_1.num_outputs);
        actiondelay_g_self->_lf__reaction_1.triggers 
                = (trigger_t***)malloc(sizeof(trigger_t**) * actiondelay_g_self->_lf__reaction_1.num_outputs);
        actiondelay_g_self->_lf__reaction_1.triggered_sizes 
                = (int*)calloc(actiondelay_g_self->_lf__reaction_1.num_outputs, sizeof(int));
    }
    // Initialize the output_produced array.
    actiondelay_g_self->_lf__reaction_1.output_produced[0]
    = &actiondelay_g_self->_lf_y_out.is_present;
    // Reaction 0 of ActionDelay.g depends on one maximal upstream reaction.
    actiondelay_g_self->_lf__reaction_0.last_enabling_reaction = &(actiondelay_source_self->_lf__reaction_0);
    // Reaction 1 of ActionDelay.g depends on one maximal upstream reaction.
    actiondelay_g_self->_lf__reaction_1.last_enabling_reaction = &(actiondelay_g_self->_lf__reaction_0);
    // Reaction 1 of ActionDelay.g triggers 1
    // downstream reactions through port ActionDelay.g.y_out.
    actiondelay_g_self->_lf__reaction_1.triggered_sizes[0] = 1;
    // For reaction 1 of ActionDelay.g, allocate an
    // array of trigger pointers for downstream reactions through port ActionDelay.g.y_out
    trigger_t** actiondelay_g_1_0 = (trigger_t**)malloc(1 * sizeof(trigger_t*));
    actiondelay_g_self->_lf__reaction_1.triggers[0] = actiondelay_g_1_0;
    // Point to destination port ActionDelay.sink.in's trigger struct.
    actiondelay_g_1_0[0] = &actiondelay_sink_self->_lf__in;
    actiondelay_g_self->_lf_y_out.num_destinations = 1;
    // doDeferredInitialize
    // Connect inputs and outputs for reactor ActionDelay.
    // Connect ActionDelay.source.out to input port ActionDelay.g.y_in
    actiondelay_g_self->_lf_y_in = (generateddelay_y_in_t*)&actiondelay_source_self->_lf_out;
    // Connect ActionDelay.g.y_out to input port ActionDelay.sink.in
    actiondelay_sink_self->_lf_in = (sink_in_t*)&actiondelay_g_self->_lf_y_out;
    // Connect inputs and outputs for reactor ActionDelay.source.
    // END Connect inputs and outputs for reactor ActionDelay.source.
    // Connect inputs and outputs for reactor ActionDelay.sink.
    // END Connect inputs and outputs for reactor ActionDelay.sink.
    // Connect inputs and outputs for reactor ActionDelay.g.
    // END Connect inputs and outputs for reactor ActionDelay.g.
    // END Connect inputs and outputs for reactor ActionDelay.
    // Add action ActionDelay.g.act to array of is_present fields.
    _lf_is_present_fields[0] 
            = &actiondelay_g_self->_lf_act.is_present;
    // Add port ActionDelay.source.out to array of is_present fields.
    _lf_is_present_fields[1] = &actiondelay_source_self->_lf_out.is_present;
    // Add port ActionDelay.g.y_out to array of is_present fields.
    _lf_is_present_fields[2] = &actiondelay_g_self->_lf_y_out.is_present;
    actiondelay_self->_lf__reaction_0.chain_id = 2;
    // index is the OR of level 0 and 
    // deadline 140737488355327 shifted left 16 bits.
    actiondelay_self->_lf__reaction_0.index = 0x7fffffffffff0000LL;
    actiondelay_source_self->_lf__reaction_0.chain_id = 1;
    // index is the OR of level 0 and 
    // deadline 140737488355327 shifted left 16 bits.
    actiondelay_source_self->_lf__reaction_0.index = 0x7fffffffffff0000LL;
    actiondelay_sink_self->_lf__reaction_0.chain_id = 1;
    // index is the OR of level 3 and 
    // deadline 140737488355327 shifted left 16 bits.
    actiondelay_sink_self->_lf__reaction_0.index = 0x7fffffffffff0003LL;
    actiondelay_g_self->_lf__reaction_0.chain_id = 1;
    // index is the OR of level 1 and 
    // deadline 140737488355327 shifted left 16 bits.
    actiondelay_g_self->_lf__reaction_0.index = 0x7fffffffffff0001LL;
    actiondelay_g_self->_lf__reaction_1.chain_id = 1;
    // index is the OR of level 2 and 
    // deadline 140737488355327 shifted left 16 bits.
    actiondelay_g_self->_lf__reaction_1.index = 0x7fffffffffff0002LL;
}
void _lf_trigger_startup_reactions() {
    
    for (int i = 0; i < _lf_startup_reactions_size; i++) {
        if (_lf_startup_reactions[i] != NULL) {
            _lf_enqueue_reaction(_lf_startup_reactions[i]);
        }
    }
}
void _lf_initialize_timers() {
}
void logical_tag_complete(tag_t tag_to_send) {
}
bool _lf_trigger_shutdown_reactions() {                          
    for (int i = 0; i < _lf_shutdown_reactions_size; i++) {
        if (_lf_shutdown_reactions[i] != NULL) {
            _lf_enqueue_reaction(_lf_shutdown_reactions[i]);
        }
    }
    // Return true if there are shutdown reactions.
    return (_lf_shutdown_reactions_size > 0);
}
void terminate_execution() {}
